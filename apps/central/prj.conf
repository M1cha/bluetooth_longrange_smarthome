## CMakeLists.txt
```
cmake_minimum_required(VERSION 3.20.0)
find_package(Zephyr REQUIRED HINTS $ENV{ZEPHYR_BASE})
project(central)

zephyr_library_named(main_bluetooth_internal)
zephyr_library_sources(
    src/bluetooth_internal.c
)
target_include_directories(${ZEPHYR_CURRENT_LIBRARY} PRIVATE
    ${ZEPHYR_BASE}/subsys/bluetooth/host
)

target_sources(app PRIVATE
    src/bluetooth.c
    src/main.c
    src/mqtt.c
)
target_link_libraries(app PRIVATE
    main_bluetooth_internal
)
```

## prj.conf
```kconfig
CONFIG_INIT_STACKS=y

CONFIG_BT=y
CONFIG_BT_DEBUG_LOG=y
CONFIG_BT_CENTRAL=y
CONFIG_BT_GATT_CLIENT=y
CONFIG_BT_RX_STACK_SIZE=8096
CONFIG_BT_L2CAP_TX_BUF_COUNT=15
CONFIG_BT_SHELL=y
CONFIG_BT_SMP=y
CONFIG_BT_SIGNING=y
CONFIG_BT_ATT_PREPARE_COUNT=5
CONFIG_BT_MAX_CONN=10
CONFIG_BT_MAX_PAIRED=10
CONFIG_BT_CTLR_TX_PWR_PLUS_8=y

CONFIG_BT_CTLR_ADV_EXT=y
CONFIG_BT_CTLR_PHY_CODED=y
CONFIG_BT_EXT_ADV=y
CONFIG_BT_USER_PHY_UPDATE=y

CONFIG_FLASH=y
CONFIG_FLASH_PAGE_LAYOUT=y
CONFIG_FLASH_MAP=y
CONFIG_NVS=y
CONFIG_SETTINGS=y
CONFIG_BT_SETTINGS=y
CONFIG_MPU_ALLOW_FLASH_WRITE=y

CONFIG_LOG=y
CONFIG_LOG_PRINTK=y
CONFIG_LOG_BUFFER_SIZE=4096
CONFIG_LOG_STRDUP_BUF_COUNT=32
CONFIG_NET_LOG=y

CONFIG_SLIP_STATISTICS=n
CONFIG_SHELL=y
CONFIG_NET_SHELL=y
CONFIG_SHELL_LOG_BACKEND=y
CONFIG_REBOOT=y

CONFIG_NETWORKING=y
CONFIG_NET_IPV6=n
CONFIG_NET_IPV4=y
CONFIG_NET_ARP=y
CONFIG_NET_UDP=y
CONFIG_NET_DHCPV4=y
CONFIG_NET_TCP=y
CONFIG_NET_MGMT=y
CONFIG_NET_MGMT_EVENT=y
CONFIG_NET_MGMT_EVENT_STACK_SIZE=4096
CONFIG_NET_SOCKETS=y
CONFIG_MQTT_LIB=y

CONFIG_USB=y
CONFIG_USB_DRIVER_LOG_LEVEL_ERR=y
CONFIG_USB_DEVICE_LOG_LEVEL_ERR=y
CONFIG_USB_DEVICE_STACK=y
CONFIG_USB_DEVICE_PRODUCT="BTLR central"
CONFIG_USB_DEVICE_NETWORK_ECM=y
```

## boards/nrf52840dk_nrf52840.conf
```kconfig
CONFIG_SHELL_BACKEND_SERIAL_INIT_PRIORITY=51

# logging already goes to the shell which goes to uart
CONFIG_LOG_BACKEND_UART=y

CONFIG_LOG_BACKEND_RTT=n
```

## boards/nrf52840dongle_nrf52840.conf
```kconfig
CONFIG_USB_CDC_ACM=y
CONFIG_UART_SHELL_ON_DEV_NAME="CDC_ACM_0"
CONFIG_SHELL_BACKEND_SERIAL_INIT_PRIORITY=51

CONFIG_LOG_BACKEND_UART=n
CONFIG_LOG_BACKEND_RTT=n
```

## src/main.c
```c
#include "main.h"

#include <fatal.h>
#include <sys/reboot.h>
#include <usb/usb_device.h>
#ifdef CONFIG_SHELL
#include <shell/shell.h>
#endif

#include <logging/log.h>
#include <logging/log_ctrl.h>
LOG_MODULE_REGISTER(main, LOG_LEVEL_DBG);

static struct k_work_delayable autoinit_work;

static void autoinit_work_handler(struct k_work *work)
{
	ARG_UNUSED(work);

	main_init_bluetooth();
	main_init_mqtt();
}

void main(void)
{
	int err;

	err = usb_enable(NULL);
	if (err) {
		LOG_ERR("Failed to enable USB");
		return;
	}
	LOG_INF("USB initialized");

	k_work_init_delayable(&autoinit_work, autoinit_work_handler);
	k_work_schedule(&autoinit_work, K_SECONDS(5));
}

void k_sys_fatal_error_handler(unsigned int reason, const z_arch_esf_t *esf)
{
	ARG_UNUSED(esf);

	LOG_PANIC();
	LOG_ERR("Resetting system");
	sys_reboot(0);
	CODE_UNREACHABLE;
}

#ifdef CONFIG_SHELL
static int cmd_main_stop(const struct shell *shell, size_t argc, char **argv)
{
	ARG_UNUSED(argc);
	ARG_UNUSED(argv);

	k_work_cancel_delayable(&autoinit_work);

	return 0;
}

SHELL_STATIC_SUBCMD_SET_CREATE(sub_main,
			       SHELL_CMD(stop, NULL, "stop autoinit", cmd_main_stop),
			       SHELL_SUBCMD_SET_END /* Array terminated. */
);
SHELL_CMD_REGISTER(main, &sub_main, "main", NULL);
#endif
```

## src/bluetooth.c
```c
#include <bluetooth/bluetooth.h>
#include <bluetooth/conn.h>
#include <bluetooth/gatt.h>
#include <bluetooth/uuid.h>
#include <settings/settings.h>
#include <sys/util.h>

#include "main.h"

#include <logging/log.h>
LOG_MODULE_REGISTER(main_bt, LOG_LEVEL_DBG);

static void start_scan(void);

struct conninfo {
	struct bt_conn *conn;

	struct bt_gatt_write_params write_params[5];
	uint8_t gatt_write_buf[5];

	struct bt_gatt_discover_params discover_params;
	uint16_t value_handle;
	struct bt_uuid_16 uuid;

	struct bt_gatt_subscribe_params sub_params[10];
};

static struct conninfo conns[CONFIG_BT_MAX_CONN];

static struct conninfo *conninfo_new(void)
{
	size_t i;

	for (i = 0; i < ARRAY_SIZE(conns); i++) {
		if (!conns[i].conn) {
			return &conns[i];
		}
	}

	return NULL;
}

static void conninfo_free(struct conninfo *ci)
{
	memset(ci, 0, sizeof(*ci));
}

static struct conninfo *conninfo_find(struct bt_conn *conn)
{
	size_t i;

	for (i = 0; i < ARRAY_SIZE(conns); i++) {
		if (conns[i].conn == conn) {
			return &conns[i];
		}
	}

	return NULL;
}

static uint8_t notify_func(struct bt_conn *conn,
			   struct bt_gatt_subscribe_params *params,
			   const void *data,
			   uint16_t length)
{
	char addr[BT_ADDR_STR_LEN];
	int rc;

	if (!data) {
		LOG_INF("[UNSUBSCRIBED] from %04x", params->value_handle);
		params->notify = NULL;
		return BT_GATT_ITER_STOP;
	}

	bt_addr_to_str(&bt_conn_get_dst(conn)->a, addr, sizeof(addr));

	rc = main_publish_characteristic_value(addr, params->value_handle, data, length);
	if (rc) {
		LOG_ERR("failed to publish characteristic value: %d", rc);
	}

	return BT_GATT_ITER_CONTINUE;
}

struct hasbond_ctx {
	bool found;
	const bt_addr_le_t *needle;
};

static void has_bond_cb(const struct bt_bond_info *info, void *ctx_)
{
	struct hasbond_ctx *ctx = ctx_;

	if (bt_addr_le_cmp(ctx->needle, &info->addr) == 0) {
		ctx->found = true;
	}
}

static void
device_found(const bt_addr_le_t *addr, int8_t rssi, uint8_t type, struct net_buf_simple *ad)
{
	int err;
	char saddr[BT_ADDR_LE_STR_LEN];
	struct bt_conn_le_create_param *conn_params;
	struct conninfo *conninfo;
	struct hasbond_ctx hasbond_ctx = {
		.found = false,
		.needle = addr,
	};

	// filter for bonded devices
	bt_foreach_bond(BT_ID_DEFAULT, has_bond_cb, &hasbond_ctx);
	if (!hasbond_ctx.found) {
		LOG_INF("not bonded");
		return;
	}

	bt_addr_le_to_str(addr, saddr, sizeof(saddr));
	LOG_INF("[DEVICE]: %s, AD evt type %u, AD data len %u, RSSI %i",
		log_strdup(saddr),
		type,
		ad->len,
		rssi);

	err = bt_le_scan_stop();
	if (err) {
		LOG_ERR("Stop LE scan failed (err %d)", err);
	}

	conninfo = conninfo_new();
	if (!conninfo) {
		LOG_ERR("failed to allocate conninfo");
		// apparently we're out of memory, don't restart scanning again.
		return;
	}

	conn_params = BT_CONN_LE_CREATE_PARAM(BT_CONN_LE_OPT_CODED | BT_CONN_LE_OPT_NO_1M,
					      BT_GAP_SCAN_FAST_INTERVAL,
					      BT_GAP_SCAN_FAST_INTERVAL);

	err = bt_conn_le_create(addr, conn_params, BT_LE_CONN_PARAM_DEFAULT, &conninfo->conn);
	if (err) {
		LOG_ERR("Create conn failed (err %d)", err);
		start_scan();
		return;
	}

	LOG_INF("Connection pending");
}

static void start_scan(void)
{
	int err;
	const struct bt_le_scan_param scan_param = {
		.type = BT_LE_SCAN_TYPE_PASSIVE,
		.interval = BT_GAP_SCAN_FAST_INTERVAL,
		.window = BT_GAP_SCAN_FAST_WINDOW,
		.options = BT_LE_SCAN_OPT_CODED | BT_LE_SCAN_OPT_NO_1M,
	};

	err = bt_le_scan_start(&scan_param, device_found);
	if (err) {
		LOG_ERR("Scanning failed to start (err %d)", err);
		return;
	}

	LOG_INF("Scanning successfully started");
}

static uint8_t discover_func(struct bt_conn *conn,
			     const struct bt_gatt_attr *attr,
			     struct bt_gatt_discover_params *params)
{
	int err;
	struct bt_gatt_chrc *gatt_chrc;
	struct conninfo *conninfo = CONTAINER_OF(params, struct conninfo, discover_params);

	if (!attr) {
		LOG_INF("Discover complete");
		goto stop;
	}

	LOG_INF("[ATTRIBUTE] handle %u", attr->handle);

	if (params->type == BT_GATT_DISCOVER_CHARACTERISTIC) {
		gatt_chrc = attr->user_data;

		if (!(gatt_chrc->properties & BT_GATT_CHRC_NOTIFY)) {
			return BT_GATT_ITER_CONTINUE;
		}

		memcpy(&conninfo->uuid, BT_UUID_GATT_CCC, sizeof(conninfo->uuid));
		params->uuid = &conninfo->uuid.uuid;
		params->start_handle = attr->handle + 2;
		params->type = BT_GATT_DISCOVER_DESCRIPTOR;

		conninfo->value_handle = bt_gatt_attr_value_handle(attr);

		err = bt_gatt_discover(conn, params);
		if (err) {
			LOG_ERR("Discover failed (err %d)", err);
			goto stop;
		}

		return BT_GATT_ITER_STOP;
	}

	if (params->type == BT_GATT_DISCOVER_DESCRIPTOR) {
		struct bt_gatt_subscribe_params *subscribe_params = NULL;
		for (size_t i = 0; i < ARRAY_SIZE(conninfo->sub_params); i++) {
			if (conninfo->sub_params[i].notify == NULL) {
				subscribe_params = &conninfo->sub_params[i];
				break;
			}
		}

		if (!subscribe_params) {
			LOG_ERR("no free subscribe params");
			goto stop;
		}

		subscribe_params->value_handle = conninfo->value_handle;
		subscribe_params->notify = notify_func;
		subscribe_params->value = BT_GATT_CCC_NOTIFY;
		subscribe_params->ccc_handle = attr->handle;
		atomic_set_bit(subscribe_params->flags, BT_GATT_SUBSCRIBE_FLAG_VOLATILE);

		err = bt_gatt_subscribe(conn, subscribe_params);
		if (err && err != -EALREADY) {
			LOG_INF("Subscribe failed (err %d)", err);
			subscribe_params->notify = NULL;
		} else {
			LOG_INF("[SUBSCRIBED] to %04x", conninfo->value_handle);
		}

		params->uuid = NULL;
		params->start_handle = attr->handle + 1;
		params->type = BT_GATT_DISCOVER_CHARACTERISTIC;

		err = bt_gatt_discover(conn, params);
		if (err) {
			LOG_ERR("Discover failed(err %d)", err);
			goto stop;
		}

		return BT_GATT_ITER_STOP;
	}

stop:
	memset(params, 0, sizeof(*params));
	start_scan();
	return BT_GATT_ITER_STOP;
}

static void connected(struct bt_conn *conn, uint8_t conn_err)
{
	int err;
	struct bt_conn_info info;
	char addr[BT_ADDR_LE_STR_LEN];
	char addr_nole[BT_ADDR_STR_LEN];
	struct conninfo *conninfo;

	conninfo = conninfo_find(conn);
	if (!conninfo) {
		LOG_ERR("connected with unknown connection");
		return;
	}

	bt_addr_le_to_str(bt_conn_get_dst(conn), addr, sizeof(addr));
	bt_addr_to_str(&bt_conn_get_dst(conn)->a, addr_nole, sizeof(addr_nole));

	if (conn_err) {
		LOG_ERR("Failed to connect to %s (%u)", log_strdup(addr), conn_err);

		bt_conn_unref(conn);
		conninfo_free(conninfo);

		start_scan();

		return;
	}

	err = main_publish_connection_status(addr_nole, true);
	if (err) {
		LOG_ERR("Failed to publish connection status: %d", err);
	}

	err = bt_conn_get_info(conn, &info);
	if (err) {
		LOG_ERR("Failed to get connection info");
	} else {
		const struct bt_conn_le_phy_info *phy_info;

		phy_info = info.le.phy;
		LOG_INF("Connected: %s, tx_phy %u, rx_phy %u",
			log_strdup(addr),
			phy_info->tx_phy,
			phy_info->rx_phy);
	}

	if (bt_conn_set_security(conn, BT_SECURITY_L2)) {
		LOG_ERR("Failed to set security");
	}

	conninfo->discover_params.uuid = NULL;
	conninfo->discover_params.func = discover_func;
	conninfo->discover_params.start_handle = BT_ATT_FIRST_ATTTRIBUTE_HANDLE;
	conninfo->discover_params.end_handle = BT_ATT_LAST_ATTTRIBUTE_HANDLE;
	conninfo->discover_params.type = BT_GATT_DISCOVER_CHARACTERISTIC;

	err = bt_gatt_discover(conn, &conninfo->discover_params);
	if (err) {
		LOG_ERR("Discover failed(err %d)", err);
		start_scan();
		return;
	}
}

static void disconnected(struct bt_conn *conn, uint8_t reason)
{
	char addr[BT_ADDR_LE_STR_LEN];
	char addr_nole[BT_ADDR_STR_LEN];
	struct conninfo *conninfo;
	int err;

	conninfo = conninfo_find(conn);
	if (!conninfo) {
		LOG_ERR("disconnected with unknown connection");
		return;
	}

	bt_addr_le_to_str(bt_conn_get_dst(conn), addr, sizeof(addr));
	bt_addr_to_str(&bt_conn_get_dst(conn)->a, addr_nole, sizeof(addr_nole));

	LOG_INF("Disconnected: %s (reason 0x%02x)", log_strdup(addr), reason);

	err = main_publish_connection_status(addr_nole, false);
	if (err) {
		LOG_ERR("Failed to publish connection status: %d", err);
	}

	bt_conn_unref(conn);
	conninfo_free(conninfo);

	start_scan();
}

static struct bt_conn_cb conn_callbacks = {
	.connected = connected,
	.disconnected = disconnected,
};

static void bt_ready(void)
{
	printk("Bluetooth initialized\n");

	if (IS_ENABLED(CONFIG_SETTINGS)) {
		settings_load();
	}
}

void main_init_bluetooth(void)
{
	int err;

	err = bt_enable(NULL);
	if (err) {
		LOG_ERR("Bluetooth init failed (err %d)", err);
		return;
	}
	LOG_INF("Bluetooth initialized");

	bt_ready();
	bt_conn_cb_register(&conn_callbacks);
	start_scan();
}

static void write_func(struct bt_conn *conn, uint8_t err, struct bt_gatt_write_params *params)
{
	LOG_INF("Write complete: err 0x%02x", err);

	memset(params, 0, sizeof(*params));
}

int main_set_bluetooth_value(const bt_addr_t *addr, uint16_t handle, void *data, size_t len)
{
	struct bt_conn *conn;
	bt_addr_le_t peer = {
		.type = BT_ADDR_LE_RANDOM,
		.a = *addr,
	};
	int err;
	struct conninfo *conninfo;
	struct bt_gatt_write_params *write_params = NULL;
	size_t paramid;

	if (len == 0) {
		LOG_ERR("No data to send");
		return -EINVAL;
	}

	if (len > sizeof(conninfo->gatt_write_buf)) {
		LOG_ERR("too much data");
		return -EINVAL;
	}

	conn = bt_conn_lookup_addr_le(BT_ID_DEFAULT, &peer);
	if (!conn) {
		LOG_ERR("can't find connection");
		return -ENOENT;
	}

	conninfo = conninfo_find(conn);
	if (!conninfo) {
		LOG_ERR("attempted write to unknown connection");
		err = -ENOENT;
		goto unref_conn;
	}

	for (paramid = 0; paramid < ARRAY_SIZE(conninfo->write_params); paramid++) {
		if (conninfo->write_params[paramid].func == NULL) {
			write_params = &conninfo->write_params[paramid];
			break;
		}
	}
	if (!write_params) {
		LOG_ERR("No free write params");
		err = -EBUSY;
		goto unref_conn;
	}

	if (write_params->func) {
		LOG_ERR("Write ongoing");
		err = -EBUSY;
		goto unref_conn;
	}

	memcpy(conninfo->gatt_write_buf, data, len);
	write_params->length = len;
	write_params->data = conninfo->gatt_write_buf;
	write_params->handle = handle;
	write_params->offset = 0;
	write_params->func = write_func;

	err = bt_gatt_write(conn, write_params);
	if (err) {
		LOG_ERR("Write failed (err %d)", err);
		goto free_write_params;
	}

	LOG_INF("Write pending");
	bt_conn_unref(conn);
	return 0;

free_write_params:
	write_params->func = NULL;
unref_conn:
	bt_conn_unref(conn);
	return err;
}

static void publish_bond_cb(const struct bt_bond_info *info, void *ctx_)
{
	int err;
	struct bt_conn *conn;
	char addr[BT_ADDR_STR_LEN];
	bool connected;

	bt_addr_to_str(&info->addr.a, addr, sizeof(addr));

	conn = bt_conn_lookup_addr_le(BT_ID_DEFAULT, &info->addr);
	connected = (conn && main_bt_conn_is_connected(conn));

	if (conn) {
		bt_conn_unref(conn);
		conn = NULL;
	}

	err = main_publish_connection_status(addr, connected);
	if (err) {
		LOG_ERR("Failed to publish connection status: %d", err);
	}
}

void main_publish_all_connection_statuses(void)
{
	bt_foreach_bond(BT_ID_DEFAULT, publish_bond_cb, NULL);
}
```

## src/bluetooth_internal.c
```c
#include <bluetooth/buf.h>
#include <bluetooth/conn.h>

#include "conn_internal.h"

bool main_bt_conn_is_connected(struct bt_conn *conn)
{
	return (conn->state == BT_CONN_CONNECTED);
}
```

## src/main.h
```c
#ifndef MAIN_H
#define MAIN_H

#include <bluetooth/addr.h>
#include <bluetooth/conn.h>

void main_init_bluetooth(void);
void main_init_mqtt(void);

int main_publish_characteristic_value(const char *addr,
				      uint16_t handle,
				      const void *data,
				      size_t data_len);
int main_publish_connection_status(const char *addr, bool connected);

bool main_bt_conn_is_connected(struct bt_conn *conn);
int main_set_bluetooth_value(const bt_addr_t *addr, uint16_t handle, void *data, size_t len);
void main_publish_all_connection_statuses(void);

#endif /* MAIN_H */
```

## src/mqtt.c
```c
#include <bluetooth/addr.h>
#include <net/mqtt.h>
#include <net/net_context.h>
#include <net/net_core.h>
#include <net/net_if.h>
#include <net/net_mgmt.h>
#include <net/socket.h>
#include <random/rand32.h>
#include <stdio.h>
#include <sys/util.h>

#include "main.h"

#include <logging/log.h>
LOG_MODULE_REGISTER(main_mqtt, LOG_LEVEL_DBG);

#define APP_RECV_TIMEOUT_MS 2000
#define APP_CONNECT_TIMEOUT_MS 2000
#define APP_SLEEP_MSECS 500
#define APP_MQTT_BUFFER_SIZE 128
#define MQTT_CLIENTID "zephyr_publisher"

static struct net_mgmt_event_callback mgmt_cb;
static K_THREAD_STACK_DEFINE(mqtt_stack_area, 4096);
static struct k_thread mqtt_thread_data;
static char topic_buf[PATH_MAX];
static char publish_data_buf[APP_MQTT_BUFFER_SIZE];
static struct mqtt_data {
	/* Buffers for MQTT client. */
	uint8_t rx_buffer[APP_MQTT_BUFFER_SIZE];
	uint8_t tx_buffer[APP_MQTT_BUFFER_SIZE];

	/* The mqtt client struct */
	struct mqtt_client client_ctx;

	/* MQTT Broker details. */
	struct sockaddr_storage broker;

	struct zsock_pollfd fds[1];
	int nfds;

	bool connected;
} mqtt_data;

static void prepare_fds(struct mqtt_client *client)
{
	if (client->transport.type == MQTT_TRANSPORT_NON_SECURE) {
		mqtt_data.fds[0].fd = client->transport.tcp.sock;
	} else {
		LOG_WRN("unsupported mqtt transport type: %d", client->transport.type);
	}

	mqtt_data.fds[0].events = ZSOCK_POLLIN;
	mqtt_data.nfds = 1;
}

static void clear_fds(void)
{
	mqtt_data.nfds = 0;
}

static int wait(int timeout)
{
	int ret = 0;

	if (mqtt_data.nfds > 0) {
		ret = zsock_poll(mqtt_data.fds, mqtt_data.nfds, timeout);
		if (ret < 0) {
			LOG_ERR("poll error: %d", errno);
		}
	}

	return ret;
}

static int read_payload(void *data_, size_t len)
{
	int ret;
	uint8_t *data = data_;

	while (len) {
		ret = mqtt_read_publish_payload(&mqtt_data.client_ctx, data, MIN(len, INT_MAX));
		if (ret == -EAGAIN) {
			ret = wait(APP_RECV_TIMEOUT_MS);
			if (ret == 0) {
				LOG_ERR("publish payload receive timeout");
				return -ETIMEDOUT;
			}
			continue;
		} else if (ret < 0) {
			LOG_ERR("failed to read payload: %d", ret);
			return ret;
		} else if (ret > len) {
			LOG_ERR("read more than requested");
			return -EIO;
		}

		data += ret;
		len -= ret;
	}

	return 0;
}

static int get_path_segment(const struct mqtt_utf8 *path, size_t n, struct mqtt_utf8 *out)
{
	const uint8_t *utf8 = path->utf8;
	uint32_t size = path->size;

	while (n) {
		if (size == 0) {
			return -ENOENT;
		}
		if (*utf8 == '/') {
			n--;
		}

		utf8++;
		size--;
	}

	out->utf8 = utf8;

	for (out->size = 0; utf8[out->size] != '/'; out->size++) {
	}

	return 0;
}

static void handle_publish(int result, const struct mqtt_publish_param *param)
{
	const struct mqtt_publish_message *message = &param->message;
	struct mqtt_puback_param puback;
	struct mqtt_pubrec_param pubrec;
	static char data[APP_MQTT_BUFFER_SIZE];
	static char rawdata[APP_MQTT_BUFFER_SIZE];
	int ret;
	struct mqtt_utf8 mac;
	struct mqtt_utf8 handle;
	char mac0[BT_ADDR_STR_LEN];
	bt_addr_t btaddr;
	char handle0[5];
	unsigned long handle_ul;
	size_t binlen;

	LOG_INF("MQTT publish received %d, %u bytes", result, message->payload.len);
	LOG_INF(" id: %d, qos: %d", param->message_id, message->topic.qos);
	LOG_HEXDUMP_DBG(message->topic.topic.utf8, message->topic.topic.size, "topic");

	if (message->payload.len > sizeof(data)) {
		uint32_t len = message->payload.len;

		LOG_WRN("message payload is too big, discard");

		while (len) {
			size_t toread = MIN(len, sizeof(data));

			ret = read_payload(data, toread);
			if (ret) {
				LOG_ERR("can't read payload: %d", ret);
				return;
			}

			len -= toread;
		}

		goto ack;
	}

	ret = read_payload(data, message->payload.len);
	if (ret) {
		LOG_ERR("can't read payload: %d", ret);
		return;
	}

	LOG_HEXDUMP_DBG(data, message->payload.len, "payload");

	binlen = hex2bin(data, message->payload.len, rawdata, ARRAY_SIZE(rawdata));
	if (!binlen) {
		LOG_ERR("can't convert payload from hex: %d", ret);
		return;
	}

	ret = get_path_segment(&message->topic.topic, 1, &mac);
	if (ret) {
		LOG_ERR("can't get mac from topic");
		goto ack;
	}

	ret = get_path_segment(&message->topic.topic, 2, &handle);
	if (ret) {
		LOG_ERR("can't get handle from topic");
		goto ack;
	}

	LOG_HEXDUMP_DBG(mac.utf8, mac.size, "mac");
	LOG_HEXDUMP_DBG(handle.utf8, handle.size, "handle");

	if (mac.size != sizeof(mac0) - 1) {
		LOG_ERR("invalid mac length");
		goto ack;
	}
	memcpy(mac0, mac.utf8, mac.size);
	mac0[mac.size] = 0;

	if (handle.size != sizeof(handle0) - 1) {
		LOG_ERR("invalid handle length");
		goto ack;
	}
	memcpy(handle0, handle.utf8, handle.size);
	handle0[handle.size] = 0;

	ret = bt_addr_from_str(mac0, &btaddr);
	if (ret) {
		LOG_ERR("can't parse bluetooth addr");
		goto ack;
	}

	errno = 0;
	handle_ul = strtoul(handle0, NULL, 16);
	if (handle_ul == 0 || handle_ul == ULONG_MAX || errno) {
		LOG_ERR("can't parse handle: %d", errno);
		goto ack;
	}

	ret = main_set_bluetooth_value(&btaddr, handle_ul, rawdata, binlen);
	if (ret) {
		LOG_ERR("can't set value: %d", ret);
		goto ack;
	}

ack:
	switch (message->topic.qos) {
	case MQTT_QOS_0_AT_MOST_ONCE:
		break;

	case MQTT_QOS_1_AT_LEAST_ONCE:
		puback.message_id = param->message_id;

		ret = mqtt_publish_qos1_ack(&mqtt_data.client_ctx, &puback);
		if (ret) {
			LOG_ERR("Failed to send MQTT PUBACK: %d", ret);
		}
		break;

	case MQTT_QOS_2_EXACTLY_ONCE:
		pubrec.message_id = param->message_id;

		ret = mqtt_publish_qos2_receive(&mqtt_data.client_ctx, &pubrec);
		if (ret) {
			LOG_ERR("Failed to send MQTT PUBREC: %d", ret);
		}
		break;

	default:
		LOG_ERR("unsupported QOS for PUBLISH: %u", message->topic.qos);
		break;
	}
}

static void mqtt_evt_handler(struct mqtt_client *const client, const struct mqtt_evt *evt)
{
	int err;

	switch (evt->type) {
	case MQTT_EVT_CONNACK:
		if (evt->result) {
			LOG_ERR("MQTT connect failed %d", evt->result);
			break;
		}

		mqtt_data.connected = true;
		LOG_INF("MQTT client connected!");

		break;

	case MQTT_EVT_DISCONNECT:
		LOG_INF("MQTT client disconnected %d", evt->result);

		mqtt_data.connected = false;
		clear_fds();

		break;

	case MQTT_EVT_PUBLISH:
		handle_publish(evt->result, &evt->param.publish);
		break;

	case MQTT_EVT_PUBACK:
		if (evt->result) {
			LOG_ERR("MQTT PUBACK error %d", evt->result);
			break;
		}

		LOG_INF("PUBACK packet id: %u", evt->param.puback.message_id);

		break;

	case MQTT_EVT_PUBREC:
		if (evt->result) {
			LOG_ERR("MQTT PUBREC error %d", evt->result);
			break;
		}

		LOG_INF("PUBREC packet id: %u", evt->param.pubrec.message_id);

		const struct mqtt_pubrel_param rel_param = { .message_id =
								     evt->param.pubrec.message_id };

		err = mqtt_publish_qos2_release(client, &rel_param);
		if (err) {
			LOG_ERR("Failed to send MQTT PUBREL: %d", err);
		}

		break;

	case MQTT_EVT_PUBREL:
		if (evt->result) {
			LOG_ERR("MQTT PUBREL error %d", evt->result);
			break;
		}

		LOG_INF("PUBREL packet id: %u", evt->param.pubrel.message_id);

		const struct mqtt_pubcomp_param comp_param = {
			.message_id = evt->param.pubrel.message_id
		};

		err = mqtt_publish_qos2_complete(client, &comp_param);
		if (err) {
			LOG_ERR("Failed to send MQTT PUBCOMP: %d", err);
		}

		break;

	case MQTT_EVT_PUBCOMP:
		if (evt->result) {
			LOG_ERR("MQTT PUBCOMP error %d", evt->result);
			break;
		}

		LOG_INF("PUBCOMP packet id: %u", evt->param.pubcomp.message_id);

		break;

	case MQTT_EVT_SUBACK:
		LOG_INF("SUBACK packet");
		break;

	case MQTT_EVT_UNSUBACK:
		LOG_INF("UNSUBACK packet");
		break;

	case MQTT_EVT_PINGRESP:
		LOG_INF("PINGRESP packet");
		break;

	default:
		LOG_WRN("unsupported MQTT event: %d", evt->type);
		break;
	}
}

static int init_broker(void)
{
	struct net_if *iface;
	struct net_if_ipv4 *ipv4;
	char buf[NET_IPV4_ADDR_LEN];
	const char *gw;
	int rc;
	struct sockaddr_in *broker4 = (struct sockaddr_in *)&mqtt_data.broker;

	iface = net_if_get_default();
	if (!iface) {
		LOG_ERR("no default netif available");
		return -1;
	}

	ipv4 = iface->config.ip.ipv4;
	if (!ipv4) {
		LOG_ERR("no ipv4 address");
		return -1;
	}

	gw = net_addr_ntop(AF_INET, &ipv4->gw, buf, sizeof(buf));
	if (!gw) {
		LOG_ERR("can't convert ipv4 gateway to string");
		return -1;
	}

	broker4->sin_family = AF_INET;
	broker4->sin_port = htons(1883);

	rc = zsock_inet_pton(AF_INET, gw, &broker4->sin_addr);
	if (rc != 1) {
		LOG_ERR("can't convert ipv4 gateway to zsock format");
		return -1;
	}

	return 0;
}

static void subscribe(void)
{
	int err;
	const char *topic = "bluetooth/+/+/set";
	struct mqtt_topic subs_topic = { .topic = { .utf8 = topic, .size = strlen(topic) },
					 .qos = MQTT_QOS_2_EXACTLY_ONCE };
	const struct mqtt_subscription_list subs_list = { .list = &subs_topic,
							  .list_count = 1U,
							  .message_id = 1U };

	err = mqtt_subscribe(&mqtt_data.client_ctx, &subs_list);
	if (err) {
		LOG_ERR("Failed to subscribe to %s item, error %d", subs_topic.topic.utf8, err);
		return;
	}

	LOG_INF("subscription requested");
}

static void connect_and_wait(void)
{
	int rc;
	struct mqtt_client *client = &mqtt_data.client_ctx;

	while (!mqtt_data.connected) {
		rc = init_broker();
		if (rc) {
			LOG_ERR("failed to init broker: %d", rc);
			k_sleep(K_MSEC(APP_SLEEP_MSECS));
			continue;
		}

		rc = mqtt_connect(client);
		if (rc != 0) {
			LOG_ERR("mqtt_connect failed: %d", rc);
			k_sleep(K_MSEC(APP_SLEEP_MSECS));
			continue;
		}

		prepare_fds(client);

		if (wait(APP_CONNECT_TIMEOUT_MS)) {
			mqtt_input(client);
		}

		if (!mqtt_data.connected) {
			mqtt_abort(client);
		}
	}

	LOG_INF("MQTT is now connected");
	subscribe();
	main_publish_all_connection_statuses();
}

static int mqtt_process_connection(void)
{
	struct mqtt_client *client = &mqtt_data.client_ctx;
	int rc;

	while (mqtt_data.connected) {
		if (wait(mqtt_keepalive_time_left(client))) {
			rc = mqtt_input(client);
			if (rc != 0) {
				LOG_ERR("mqtt_input failed: %d", rc);
				return rc;
			}
		}

		rc = mqtt_live(client);
		if (rc != 0 && rc != -EAGAIN) {
			LOG_ERR("mqtt_live failed: %d", rc);
			return rc;
		} else if (rc == 0) {
			rc = mqtt_input(client);
			if (rc != 0) {
				LOG_ERR("mqtt_input failed: %d", rc);
				return rc;
			}
		}
	}

	return 0;
}

static void mqtt_thread(void *_a, void *_b, void *_c)
{
	int rc;
	struct mqtt_client *client = &mqtt_data.client_ctx;

	LOG_INF("MQTT thread started");

	for (;;) {
		connect_and_wait();

		rc = mqtt_process_connection();
		LOG_INF("mqtt_process_connection returned with: %d", rc);

		if (mqtt_data.connected) {
			mqtt_disconnect(client);
		} else {
			mqtt_abort(client);
		}
	}
}

static void
net_mgmt_handler(struct net_mgmt_event_callback *cb, uint32_t mgmt_event, struct net_if *iface)
{
	int i = 0;

	if (mgmt_event != NET_EVENT_IPV4_ADDR_ADD) {
		return;
	}

	for (i = 0; i < NET_IF_MAX_IPV4_ADDR; i++) {
		char buf[NET_IPV4_ADDR_LEN];

		if (iface->config.ip.ipv4->unicast[i].addr_type != NET_ADDR_DHCP) {
			continue;
		}

		LOG_INF("Your address: %s",
			log_strdup(net_addr_ntop(AF_INET,
						 &iface->config.ip.ipv4->unicast[i].address.in_addr,
						 buf,
						 sizeof(buf))));
		LOG_INF("Lease time: %u seconds", iface->config.dhcpv4.lease_time);
		LOG_INF("Subnet: %s",
			log_strdup(net_addr_ntop(
				AF_INET, &iface->config.ip.ipv4->netmask, buf, sizeof(buf))));
		LOG_INF("Router: %s",
			log_strdup(net_addr_ntop(
				AF_INET, &iface->config.ip.ipv4->gw, buf, sizeof(buf))));
	}
}

void main_init_mqtt(void)
{
	struct mqtt_client *client = &mqtt_data.client_ctx;

	mqtt_client_init(client);

	/* MQTT client configuration */
	client->broker = &mqtt_data.broker;
	client->evt_cb = mqtt_evt_handler;
	client->client_id.utf8 = (uint8_t *)MQTT_CLIENTID;
	client->client_id.size = strlen(MQTT_CLIENTID);
	client->password = NULL;
	client->user_name = NULL;
	client->protocol_version = MQTT_VERSION_3_1_1;

	/* MQTT buffers configuration */
	client->rx_buf = mqtt_data.rx_buffer;
	client->rx_buf_size = sizeof(mqtt_data.rx_buffer);
	client->tx_buf = mqtt_data.tx_buffer;
	client->tx_buf_size = sizeof(mqtt_data.tx_buffer);

	/* MQTT transport configuration */
	client->transport.type = MQTT_TRANSPORT_NON_SECURE;

	net_mgmt_init_event_callback(&mgmt_cb, net_mgmt_handler, NET_EVENT_IPV4_ADDR_ADD);
	net_mgmt_add_event_callback(&mgmt_cb);

	net_dhcpv4_start(net_if_get_default());

	k_thread_create(&mqtt_thread_data,
			mqtt_stack_area,
			K_THREAD_STACK_SIZEOF(mqtt_stack_area),
			mqtt_thread,
			NULL,
			NULL,
			NULL,
			K_PRIO_COOP(CONFIG_NUM_COOP_PRIORITIES - 1),
			0,
			K_NO_WAIT);
}

int main_publish_characteristic_value(const char *addr,
				      uint16_t handle,
				      const void *data,
				      size_t data_len)
{
	struct mqtt_publish_param param;
	int rc;
	size_t hex_len;

	if (!mqtt_data.connected) {
		return -ENOTCONN;
	}

	rc = snprintf(topic_buf, sizeof(topic_buf), "bluetooth/%s/%04x/state", addr, handle);
	if (rc < 0 || (size_t)rc >= sizeof(topic_buf)) {
		return -ENOMEM;
	}

	hex_len = bin2hex(data, data_len, publish_data_buf, sizeof(publish_data_buf));
	if (!hex_len) {
		return -ENOMEM;
	}

	param.message.topic.qos = MQTT_QOS_1_AT_LEAST_ONCE;
	param.message.topic.topic.utf8 = (uint8_t *)topic_buf;
	param.message.topic.topic.size = (size_t)rc;
	param.message.payload.data = publish_data_buf;
	param.message.payload.len = hex_len;
	param.message_id = sys_rand32_get();
	param.dup_flag = 0U;
	param.retain_flag = 1U;

	return mqtt_publish(&mqtt_data.client_ctx, &param);
}

int main_publish_connection_status(const char *addr, bool connected)
{
	struct mqtt_publish_param param;
	int rc;

	if (!mqtt_data.connected) {
		return -ENOTCONN;
	}

	rc = snprintf(topic_buf, sizeof(topic_buf), "bluetooth/%s/connected", addr);
	if (rc < 0 || (size_t)rc >= sizeof(topic_buf)) {
		return -ENOMEM;
	}

	if (sizeof(topic_buf) < 2) {
		return -ENOMEM;
	}

	publish_data_buf[0] = '0';
	publish_data_buf[1] = connected ? '1' : '0';

	param.message.topic.qos = MQTT_QOS_1_AT_LEAST_ONCE;
	param.message.topic.topic.utf8 = (uint8_t *)topic_buf;
	param.message.topic.topic.size = (size_t)rc;
	param.message.payload.data = publish_data_buf;
	param.message.payload.len = 2;
	param.message_id = sys_rand32_get();
	param.dup_flag = 0U;
	param.retain_flag = 1U;

	return mqtt_publish(&mqtt_data.client_ctx, &param);
}
```
